#include "Dumbpad.dtsi"

/ {
    chosen {
        zmk,kscan = &kscan0;
    };

    kscan0: kscan {
        compatible = "zmk,kscan-gpio-matrix";

        diode-direction = "col2row";
        col-gpios
            = <&pro_micro 8 GPIO_ACTIVE_HIGH>
            , <&pro_micro 16 GPIO_ACTIVE_HIGH>
            , <&pro_micro 15 GPIO_ACTIVE_HIGH>
            , <&pro_micro 14 GPIO_ACTIVE_HIGH>
            , <&pro_micro 13 GPIO_ACTIVE_HIGH>
            ;

    };

};

&left_encoder {
    status = "okay";
};