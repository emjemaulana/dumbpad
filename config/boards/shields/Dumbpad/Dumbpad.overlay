#include <dt-bindings/zmk/matrix_transform.h>

/ {
    chosen {
        zmk,kscan = &kscan0;
    };
    
    kscan0: kscan_0 {
        compatible = "zmk,kscan-gpio-matrix";
        diode-direction = "col2row";

        col-gpios
            = <&pro_micro 8 GPIO_ACTIVE_HIGH>
            , <&pro_micro 16 GPIO_ACTIVE_HIGH>
            , <&pro_micro 15 GPIO_ACTIVE_HIGH>
            , <&pro_micro 14 GPIO_ACTIVE_HIGH>
            , <&pro_micro 13 GPIO_ACTIVE_HIGH>
            ;

        row-gpios
            = <&pro_micro 20 (GPIO_ACTIVE_HIGH | GPIO_PULL_DOWN)>
            , <&pro_micro 19 (GPIO_ACTIVE_HIGH | GPIO_PULL_DOWN)>
            , <&pro_micro 18 (GPIO_ACTIVE_HIGH | GPIO_PULL_DOWN)>
            , <&pro_micro 17 (GPIO_ACTIVE_HIGH | GPIO_PULL_DOWN)>
            ;
    }:

    default_transform: keymap_transform_0 {
        compatible = "zmk,matrix-transform";
        columns = <5>;
        rows = <4>;

        ap = <
            RC(0,1) RC(0,2) RC(0,3) RC(0,4)
            RC(1,1) RC(1,2) RC(1,3) RC(1,4)
            RC(2,1) RC(2,2) RC(2,3) RC(2,4)
    RC(3,0) RC(3,1) RC(3,2) RC(3,3) RC(3,4)   
        >;  
        };
};
        